## boards/shields/paging/Kconfig.defconfig
```kconfig
if SHIELD_PAGING

config ZMK_KEYBOARD_NAME
    default "paging"
      
endif

if ZMK_BACKLIGHT

config PWM
    default y

config LED_PWM
    default y

endif # ZMK_BACKLIGHT

if ZMK_DISPLAY

config I2C
    default y

config SSD1306
    default y

endif # ZMK_DISPLAY

if LVGL

config LV_Z_VDB_SIZE
    default 64

config LV_DPI_DEF
    default 148

config LV_Z_BITS_PER_PIXEL
    default 1

choice LV_COLOR_DEPTH
    default LV_COLOR_DEPTH_1
endchoice

endif # LVGL


config ZMK_LAYER_INDICATOR
    bool "Enable layer indicator driver"
    default y
    help
      Enables the layer indicator driver for monitoring layer state changes.
      
config ZMK_LAYER_INDICATOR_MAX_EVENTS
    int "Maximum number of layer events to queue"
    default 20
    depends on ZMK_LAYER_INDICATOR
    help
      Maximum number of layer state change events that can be queued for processing.
      
config ZMK_LAYER_INDICATOR_LOG_ALL_TRANSITIONS
    bool "Log all layer transitions"
    default n
    depends on ZMK_LAYER_INDICATOR
    help
      When enabled, logs every layer state change event. When disabled, only logs when
      the total number of active layers changes.
```

## boards/shields/paging/Kconfig.shield
```kconfig
config SHIELD_PAGING
    def_bool $(shields_list_contains,paging)

config ZMK_SHIELD_PAGING
    bool "Paging shield"
    depends on ZMK
```

## boards/shields/paging/drivers/charging_status/Kconfig
```kconfig
config CHARGING_STATUS
    bool "TP4056 charging status driver"
    default y
    depends on GPIO
    select LOG
    help
      Interrupt-based TP4056 charging detection with breathing LED indicator.

config CHARGING_STATUS_LOG_LEVEL
    int "Charging status log level"
    default 3
    depends on CHARGING_STATUS
```

## boards/shields/paging/dts/bindings/bluetooth-status.yaml
```yaml
# Copyright (c) 2025 Your Name
# SPDX-License-Identifier: MIT

description: Bluetooth connection status LED indicator

compatible: "bluetooth-status"

properties:
  gpios:
    required: true
    type: phandle-array
    description: GPIO specifier for the status LED
```

## boards/shields/paging/dts/bindings/charging-status.yaml
```yaml
# SPDX-License-Identifier: MIT

description: Charging status detector with PWM breathing LED indicator.

compatible: "zmk,charging-status"

include:
  - name: base.yaml
  - name: gpio.yaml
  - name: pwm.yaml

properties:
  charge-gpios:
    type: phandle-array
    required: true
    description: |
      GPIO input used to detect charging status.
      Active low.

  pwms:
    type: phandle-array
    required: true
    description: |
      PWM specifier used to drive the charging LED.
      The PWM output must be mapped to a GPIO pin via pinctrl.
```

## boards/shields/paging/dts/bindings/charging_status.yaml
```yaml
description: Charging status sensor for TP4056 CHRG pin

compatible: "zmk,charging-status"

include: sensor-device.yaml

properties:
  gpios:
    type: phandle-array
    required: true
    description: GPIO pin connected to TP4056 CHRG (e.g., P1.09 on nRF52840).
  led-gpios:
    type: phandle-array
    required: false
    description: GPIO pin for LED indicator (e.g., P1.06 on nRF52840, for breathing effect during charging).
```

## boards/shields/paging/dts/bindings/zmk,charging-status.yaml
```yaml
description: TP4056 charging status detector

compatible: "zmk,charging-status"

properties:
  chrg-gpios:
    type: phandle-array
    required: true
    description: |
      GPIO connected to TP4056 CHRG pin (open-drain, low active)

  led-gpios:
    type: phandle-array
    required: true
    description: |
      Charging indicator LED GPIO
```
